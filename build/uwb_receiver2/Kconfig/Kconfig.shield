## build/uwb_receiver2/Kconfig/Kconfig.shield
```kconfig
osource "C:/ncs/v2.9.1/nrf/boards/shields/*/Kconfig.shield"
osource "C:/ncs/v2.9.1/modules/hal/qorvo/boards/shields/*/Kconfig.shield"
```

## build/uwb_receiver2/Kconfig/Kconfig.shield.defconfig
```kconfig
osource "C:/ncs/v2.9.1/nrf/boards/shields/*/Kconfig.defconfig"
osource "C:/ncs/v2.9.1/modules/hal/qorvo/boards/shields/*/Kconfig.defconfig"
```
